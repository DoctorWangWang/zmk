## app/drivers/sensor/Kconfig
```kconfig
# Copyright (c) 2020 The ZMK Contributors
# SPDX-License-Identifier: MIT

rsource "battery/Kconfig"
rsource "ec11/Kconfig"

rsource "cirque_trackpad/Kconfig"
rsource "pmw33xx/Kconfig"
rsource "pixart/pmw3360/Kconfig"
rsource "pixart/paw3395/Kconfig"
rsource "pixart/pmw3610/Kconfig"
```

## app/drivers/sensor/battery/Kconfig
```kconfig
# Copyright (c) 2020-2021 The ZMK Contributors
# SPDX-License-Identifier: MIT

DT_COMPAT_ZMK_BATTERY_NRF_VDDH := zmk,battery-nrf-vddh
DT_COMPAT_ZMK_BATTERY_VOLTAGE_DIVIDER := zmk,battery-voltage-divider
DT_COMPAT_ZMK_BATTERY_MAX17048 := zmk,battery-max17048

config ZMK_BATTERY
	bool "ZMK battery monitoring"
	help
		Enable battery monitoring

config ZMK_BATTERY_NRF_VDDH
	bool
	default $(dt_compat_enabled,$(DT_COMPAT_ZMK_BATTERY_NRF_VDDH))
	select ADC
	select ZMK_BATTERY
	help
		Enable ZMK nRF VDDH voltage driver for battery monitoring.

config ZMK_BATTERY_VOLTAGE_DIVIDER
	bool
	default $(dt_compat_enabled,$(DT_COMPAT_ZMK_BATTERY_VOLTAGE_DIVIDER))
	select ADC
	select ZMK_BATTERY
	help
		Enable ZMK battery voltage divider driver for battery monitoring.

config ZMK_BATTERY_MAX17048
	bool "MAX17048 Fuel Gauge"
	default $(dt_compat_enabled,$(DT_COMPAT_ZMK_BATTERY_MAX17048))
  select I2C
	select ZMK_BATTERY
	help
	  Enable I2C-based driver for MAX17048/9 Fuel Gauge. Supports measuring
	  battery voltage and state-of-charge.

module = BATTERY
module-str = battery
source "${ZEPHYR_BASE}/subsys/logging/Kconfig.template.log_config"
```
